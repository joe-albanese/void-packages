## srcpkgs/framework-dc-roma-kernel/files/uboot.its
```
/dts-v1/;

/ {
    description = "U-boot FIT image for visionfive2";
    #address-cells = <1>;

    images {
        vmlinux {
            description = "vmlinux";
            data = /incbin/("arch/riscv/boot/Image");
            type = "kernel";
            arch = "riscv";
            os = "linux";
            compression = "none";
            load = <0x40200000>;
            entry = <0x40200000>;
            hash-1 { algo = "sha256"; };
        };
        fdt {
            data = /incbin/("arch/riscv/boot/dts/starfive/jh7110-deepcomputing-fml13v01.dtb");
            type = "flat_dt";
            arch = "riscv";
            compression = "none";
            load = <0x46000000>;
            hash-1 { algo = "sha256"; };
        };
    };

    configurations {
        default = "config-1";

        config-1 {
            description = "visionfive2 with opensbi";
            kernel = "vmlinux";
            fdt = "fdt";
        };
    };
};
```
